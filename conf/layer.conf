## conf/layer.conf
```bitbake
# We have a conf and classes directory, add to BBPATH
BBPATH .= ":${LAYERDIR}"

# We have recipes-* directories, add to BBFILES
BBFILES += "${LAYERDIR}/recipes-*/*/*.bb \
	${LAYERDIR}/recipes-*/*/*.bbappend"

BBFILE_COLLECTIONS += "cognomotiv"
BBFILE_PATTERN_cognomotiv = "^${LAYERDIR}/"
BBFILE_PRIORITY_cognomotiv = "1"
```
